/dts-v1/;
/plugin/;

/ {
	compatible = "allwinner,sun50i-h618", "allwinner,sun50i-h616";

	fragment@0 {
		target-path = "/leds/led-0";
		__overlay__ {
			linux,default-trigger = "heartbeat";
		};
	};
};
